## Linux Kernel Programming and Introduction to Yocto Project/assignment-8/base_external/package/ldd/Config.in
```kconfig
config BR2_PACKAGE_LDD
	bool "ldd"
	help
	  Includes the scull and faulty driver
```
